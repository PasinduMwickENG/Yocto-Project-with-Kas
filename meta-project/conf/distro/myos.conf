## meta-project/conf/distro/myos.conf
```bitbake
require conf/distro/poky.conf

DISTRO = "myos"
DISTRO_NAME = "PasinduW Custom Embedded OS"
DISTRO_VERSION = "1.0"
DISTRO_CODENAME = "alpha"
MAINTAINER = "PasinduW <pasinduw@zone24x7.com>"
```

## meta-project/conf/layer.conf
```bitbake
# We have a conf and classes directory, add to BBPATH
BBPATH .= ":${LAYERDIR}"

# We have recipes-* directories, add to BBFILES
BBFILES += "${LAYERDIR}/recipes-*/*/*.bb \
            ${LAYERDIR}/recipes-*/*/*.bbappend"

BBFILE_COLLECTIONS += "meta-project"
BBFILE_PATTERN_meta-project = "^${LAYERDIR}/"
BBFILE_PRIORITY_meta-project = "6"

LAYERDEPENDS_meta-project = "core"
LAYERSERIES_COMPAT_meta-project = "scarthgap"




#stuff i added

IMAGE_INSTALL:append = " os-release"
LICENSE_FLAGS_ACCEPTED:append = "synaptics-killswitch"

INHERIT += "extrausers"
EXTRA_USERS_PARAMS = "usermod -p '\$6\$gZasefmWSxlTrUw9\$8OxvkSIUokUIkcpjSNUivnC3ySoOYhUSIWlt35Z7NEb.XERHDWtwedhGcWe6ch7/WTS0piCEgPBdaQOb.hAZB.' root;"

IMAGE_FEATURES += "ssh-server-dropbear"
IMAGE_FEATURES:append = " allow-root-login"

ENABLE_UART = "1"
```
